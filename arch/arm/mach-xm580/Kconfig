## arch/arm/mach-xm580/Kconfig
```kconfig
if ARCH_XM580

menu "xm580 board feature"

config MACH_XM580
	bool "Support xm580 platform"
	select CPU_V7
	select ARM_GIC
	select ARM_TIMER_SP804
	select COMMON_CLK 
	select PL330
	select DMA_SHARED_BUFFER
	select HAVE_ARM_TWD
	select GENERIC_IRQ_MULTI_HANDLER
	help
	  Includes support for the  xm580 platform.

	  This includes specific configurations for the module and
	  its peripherals.

config XM580_RTC
	bool "Add support for XM 580 RTC"
	default "y"
	help
	  Includes support for the xm580 RTC device.

config XM580_VO
	bool "Add support for XM 580 Video Output"
	default "y"
	help
	  Includes support for the xm580 VO device.

config XM580_AUDIO
	bool "Add support for XM 580 Audio Output"
	default "y"
	help
	  Includes support for the xm580 Audio device.

config MXC_HANTRO
	bool "Add support for video encoder"
	default "y"
	help
	  Includes support for the xm580 video encoder device.

config USB_DWCOTG
	bool "Add support for DWC USB controller"
	default "y"
	help
	  Includes support for the xm580 DWC 2 usb controller

menuconfig NETDEV_1000
	bool "Ethernet (1000 Mbit)"
	depends on !UML
	default y

if NETDEV_1000

	source "arch/arm/mach-xm580/xmmac/Kconfig"

endif

endmenu

endif
```
